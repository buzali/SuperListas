/*********************************************************************
 *
 *                  LCD.c
 * 
*********************************************************************/

#include "HardwareProfile.h"
#include "Dogm/utility/dogm128.h"
#include <libpic30.h>
#include "LCD.h"
#include <stdlib.h>

//SuperListas Logo
const unsigned char logo_win [] = {
0x00, 0x00, 0x00, 0x00, 0x00, 0x00, 0x00, 0x00, 0x00, 0x00, 0x00, 0x00, 0x00, 0x00, 0x00, 0x00,
0x00, 0x00, 0x00, 0x00, 0x00, 0x00, 0x00, 0x00, 0x00, 0x00, 0x00, 0x00, 0x00, 0x00, 0x00, 0x00,
0x00, 0x00, 0x00, 0x00, 0x00, 0x00, 0x00, 0x00, 0x00, 0x00, 0x00, 0x00, 0x00, 0x00, 0x00, 0x00,
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0x00, 0x00, 0x00, 0x00, 0x00, 0x00, 0x00, 0x00, 0x00, 0x00, 0x00, 0x00, 0x00, 0x00, 0x00, 0x00
};


#define width       128
#define c_width     6
#define c_height    13
#define lines       5


//Prints SuperListas Logo 
void LCD_printLogo(void)
{
      int i=0;
  int a = 1000;
      dog_StartPage();
  do
  {
    dog_SetBitmap(i,63,logo_win,127,63);
  } while( dog_NextPage() );
  __delay_ms(50);

}

//Initializes LCD Display
void LCD_init(void)
{
    dog_InitA0CS(LCD_A0_O, LCD_CS_O);
}




//Print string s, split in multiple lines if necessary
void LCD_printStr(const char *s)
{
    char primera[lines][22] = {'\0'};
    int fila = 0;
    char delim[5] = ", .";
    //Divide s en diferentes filas y las pone en el array de chars
    char *word = strtok(s, delim);
    while (word != NULL)
        {
        if (!((strlen(primera[fila]) + strlen(word)) < width/c_width))
            fila ++;
        if (fila >lines - 1)
            break;
        strcat(primera[fila], word);
        strcat(primera[fila], " ");
            //primera[fila]
        word = strtok(NULL, delim);
    }
    int i;
    i=0;

    //LCD_printMultilinea(primera, fila);
  dog_StartPage();
  do{
    for (i=0; i<=fila ;i++){
    dog_DrawStr(0, 52- c_height*i, font_6x13, primera[i]);
    }
  } while( dog_NextPage() );

}

